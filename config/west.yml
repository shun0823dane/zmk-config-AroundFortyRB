## config/west.yml
```yaml
manifest:
  remotes:
    - name: zmkfirmware
      url-base: https://github.com/zmkfirmware
    # PMW3610センサーモジュール
    - name: badjeff
      url-base: https://github.com/badjeff
    # RGB Widgetモジュール
    - name: caksoylar
      url-base: https://github.com/caksoylar
    # 閾値モジュール
    - name: yamaryu211
      url-base: https://github.com/yamaryu211
  projects:
    - name: zmk
      remote: zmkfirmware
      revision: v0.3.0
      import: app/west.yml
    - name: zmk-pmw3610-driver
      remote: badjeff
      revision: zmk-0.3
    - name: zmk-rgbled-widget
      remote: caksoylar
      revision: v0.3-branch
      
    # 【追加】閾値モジュールの実体をダウンロードする指定
    - name: zmk-input-processor-temp-layer-threshold
      remote: yamaryu211
      revision: e7f39d5a61bc697d4f7e9a28212568fbda81d676
      
  self:
    path: config
```
