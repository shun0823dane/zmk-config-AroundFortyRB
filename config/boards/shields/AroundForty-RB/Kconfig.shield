## config/boards/shields/AroundForty-RB/Kconfig.shield
```kconfig
config SHIELD_MOGA_R
    def_bool $(shields_list_contains,AroundForty-RB_R)

config SHIELD_MOGA_L
    def_bool $(shields_list_contains,AroundForty-RB_L)
```

## config/boards/shields/ArroundForty-RB/Kconfig.defconfig
```kconfig
if SHIELD_MOGA_R

config ZMK_KEYBOARD_NAME
    default "ArroundForty-RB_R"

config ZMK_SPLIT
    default y

config ZMK_SPLIT_ROLE_CENTRAL
    default y

endif

if SHIELD_MOGA_L

config ZMK_KEYBOARD_NAME
    default "ArroundForty-RB_L"

config ZMK_SPLIT
    default y

endif
```

## config/boards/shields/ArroundForty-RB/Kconfig.shield
```kconfig
config SHIELD_MOGA_R
    def_bool $(shields_list_contains,ArroundForty-RB_R)

config SHIELD_MOGA_L
    def_bool $(shields_list_contains,ArroundForty-RB_L)
```
